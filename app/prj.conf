## CMakeLists.txt
```
cmake_minimum_required(VERSION 3.20.0)

set(CMAKE_EXPORT_COMPILE_COMMANDS ON)

set(EXTRA_CONF_FILE ${CMAKE_CURRENT_SOURCE_DIR}/sign.conf)

# Real device secrets (CONFIG_PIGEON_ENDPOINT/CONFIG_PIGEON_TOKEN) live in a
# gitignored prj.local.conf, auto-merged if present -- same convention as the
# sibling pigeon-examples repo's samples. Never commit one or paste its
# contents into a transcript.
if(EXISTS ${CMAKE_CURRENT_SOURCE_DIR}/prj.local.conf)
  list(APPEND EXTRA_CONF_FILE ${CMAKE_CURRENT_SOURCE_DIR}/prj.local.conf)
endif()

# CONFIG_PIGEON_FOTA_CURRENT_VERSION must track this build's own version --
# the pigeon library compares it byte-for-byte against the shadow firmware
# target's version string, and a stale value either loops re-downloading the
# already-running image or never converges (see pigeon's zephyr/Kconfig).
# Derived here from the same VERSION file Zephyr's app-version machinery
# reads, so there is exactly one place to bump and no second constant to
# forget. Written as a generated conf fragment appended to EXTRA_CONF_FILE
# (the prj.local.conf mechanism above) because that is the only assignment
# path sysbuild honors: under sysbuild, plain CMake CONFIG_* set()s are
# only consumed from the sysbuild cache (see zephyr/cmake/modules/
# kconfig.cmake's SYSBUILD branch), never from the app CMakeLists. The
# platform-side firmware catalog entry for an image built from this tree
# must be uploaded under this exact MAJOR.MINOR.PATCHLEVEL string (see
# README, FOTA test procedure).
file(READ ${CMAKE_CURRENT_SOURCE_DIR}/VERSION edb_version_file)
string(REGEX MATCH "VERSION_MAJOR *= *([0-9]+)" edb_unused "${edb_version_file}")
set(edb_version_major ${CMAKE_MATCH_1})
string(REGEX MATCH "VERSION_MINOR *= *([0-9]+)" edb_unused "${edb_version_file}")
set(edb_version_minor ${CMAKE_MATCH_1})
string(REGEX MATCH "PATCHLEVEL *= *([0-9]+)" edb_unused "${edb_version_file}")
set(edb_version_patch ${CMAKE_MATCH_1})
if(NOT (edb_version_major MATCHES "^[0-9]+$" AND edb_version_minor MATCHES "^[0-9]+$"
        AND edb_version_patch MATCHES "^[0-9]+$"))
  message(FATAL_ERROR "Could not parse MAJOR/MINOR/PATCHLEVEL out of app/VERSION")
endif()
file(WRITE ${CMAKE_CURRENT_BINARY_DIR}/pigeon_fota_version.conf
  "CONFIG_PIGEON_FOTA_CURRENT_VERSION=\"${edb_version_major}.${edb_version_minor}.${edb_version_patch}\"\n")
list(APPEND EXTRA_CONF_FILE ${CMAKE_CURRENT_BINARY_DIR}/pigeon_fota_version.conf)

find_package(Zephyr REQUIRED HINTS $ENV{ZEPHYR_BASE})
project(embedded-departure-board)

# Generate hex files from pem files
set(gen_dir ${ZEPHYR_BINARY_DIR}/include/generated/)
zephyr_include_directories(${gen_dir})

foreach(inc_file
  pigeon-ca.crt
  swiftly-ca-full.crt
)
  generate_inc_file_for_target(
    app
    keys/public/${inc_file}
    ${gen_dir}/${inc_file}.hex
  )
endforeach()

if(NOT EXISTS ${CMAKE_CURRENT_SOURCE_DIR}/keys/private/swiftly-api.key)
  write_file(${CMAKE_CURRENT_SOURCE_DIR}/keys/private/swiftly-api.key \"ffffffffffffffffffffffffffffffff\")
endif()

target_include_directories(app PRIVATE ${CMAKE_CURRENT_SOURCE_DIR}/src)

# pigeon's cross-transport TLS handshake lock is declared in the library's
# own src/pigeon_internal.h, not in the <pigeon.h> it publishes. This app's
# Swiftly client is a second TLS client on the same modem and has to take
# that lock (see net/custom_http_client.c), so take the declaration from
# where it lives instead of restating the prototype here: C links a
# locally-declared prototype against a changed definition without
# complaint, where an include fails the build.
target_include_directories(app PRIVATE ${ZEPHYR_PIGEON_MODULE_DIR}/src)

FILE(GLOB_RECURSE app_sources src/*.c)
target_sources(app PRIVATE ${app_sources})

target_compile_definitions(app PRIVATE _POSIX_C_SOURCE=200809L)
SET_SOURCE_FILES_PROPERTIES( ${app_sources} APPEND PROPERTIES COMPILE_FLAGS -fanalyzer )
```

## Kconfig
```
menu "Embedded Departure Board"
source "Kconfig.zephyr"

#### LED DISPLAY TEST SETTINGS ####
config LED_DISPLAY_TEST
  bool "Select to run LED display test instead of main application"

#### STOP SETTINGS ####
config STOP_ID
  string "Bus stop ID"
  help
    Identifies one stop, so it has no default here. Set it in the untracked
    app/prj.local.conf; an unset value fails the build.

config STOP_MAX_ROUTES
  int "Maximum number of routes expected at the configured stop"
  default 5

config ROUTE_MAX_DEPARTURES
  int "Maximum number of departures expected for EACH route"
  default 2

#### SIGN SETTINGS ####

config UPDATE_STOP_FREQUENCY_SECONDS
  int "The frequency at which stop departure times are updated in seconds"
  default 30

config NUMBER_OF_DISPLAY_BOXES
  int "The number of display boxes connected to the sign"
  default 6

config MAX_TIME_INACTIVE_BEFORE_RESET_MS
  int "Maximum amount of time the system can remain inactive before it resets in milliseconds"
  default 60000

#### LIGHT_SENSOR SETTINGS ####

config LIGHT_SENSOR
  bool "Enable I2C ambient light sensor"
  default y

#### HTTP stop request settings ####

config HTTP_REQUEST_RETRY_COUNT
  int "Defines the number of HTTP request retries on failure (i.e. 404)"
  default 0

config STOP_JSON_BUF_SIZE
  int "Defines the max size for stop JSON response body receive buffer"
  default 4096

## SWIFTLY ##
config SWIFTLY_API_HOSTNAME
  string "Swiftly API hostname used to retrieve stop predictions data"
  default "api.goswift.ly"

config SWIFTLY_API_PATH
  string "Swiftly API HTTP path used to retrieve stop predictions data"
  help
    The path selects a transit agency, so it has no default here. Set it in the
    untracked app/prj.local.conf; an unset value fails the build.

config SWIFTLY_API_NUMBER_OF_PREDICTIONS
  string "The number of future predictions to return per route/stop in the response"
  default "1"

#### NTP SETTINGS ####

config PRIMARY_NTP_SERVER
  string "Primary NTP server used to synchronize system time"
  default "time.nist.gov"

config FALLBACK_NTP_SERVER
  string "Fallback NTP server used to synchronize system time if the primary server is unavailable"
  default "us.pool.ntp.org"

config NTP_REQUEST_TIMEOUT_MS
  int "Max amount of time allowed waiting for a single NTP query response for in milliseconds"
  # The NIST time servers should never be queried more frequently than once every 4 seconds.
  default 4000

config NTP_FETCH_RETRY_COUNT
  int "Max attempts to fetch time from NTP server before changing to fallback server"
  default 2

endmenu
```

## west.yml
```
# Import requirements for nRF9160 Feather Examples and Drivers
manifest:
  remotes:
    - name: ncs
      url-base: https://github.com/nrfconnect

  projects:
    - name: nrf
      repo-path: sdk-nrf
      remote: ncs
      revision: v3.4.0
      import:
         name-allowlist:
          - cmsis_6
          - hal_nordic
          - mbedtls
          - mcuboot
          - nrfxlib
          - oberon-psa-crypto
          - segger
          - tf-psa-crypto
          - trusted-firmware-m
          - zcbor
          - zephyr

    # Multiplexer Driver
    - name: multiplexer
      url: https://github.com/justins-engineering/zephyr-multiplexer
      # Explicit SHA rather than a branch name, for the same reason as pigeon
      # below: a branch resolves to whatever it has become since the build.
      revision: 09a535cecfa8ef3726e026ac58a431aedfc9427c
      path: multiplexer

    # Pigeon: PidgeIoT device client library (device shadow / telemetry /
    # remote stop config). A real west project here, not a local symlink
    # (contrast the sibling pigeon-examples repo, which symlinks a live
    # ~/pigeon checkout for active co-development) -- this is a product
    # repo, not a dev sandbox, and needs a build that reproduces on any
    # machine/CI runner without depending on a local out-of-tree checkout
    # existing. zephyr/module.yml wires it in automatically once fetched;
    # no ZEPHYR_EXTRA_MODULES/CMakeLists changes needed.
    #
    # Pinned to an explicit commit, never a branch. A shipped image must be
    # rebuildable from this manifest alone; `revision: main` instead resolves
    # to whatever the library has become since, so the artifact that was
    # tested and the artifact a rebuild produces can silently differ with no
    # change to this repo at all. Advancing this pin is a deliberate,
    # separately-tested change, not a side effect of fetching.
    - name: pigeon
      url: https://github.com/justins-engineering/pigeon
      revision: 7b2824318e1d41ed1377b79f924e80d7d90dc2e8
      path: pigeon

  self:
    path: app
```

## prj.conf
```kconfig
# TF-M's "profile not set" build (see CONFIG_TFM_PROFILE_TYPE_NOT_SET in this
# board's conf) unconditionally enables TFM_EXPERIMENTAL
CONFIG_WARN_EXPERIMENTAL=n

# Set LIBC
CONFIG_PICOLIBC=y

# PicolibC targets C17 and POSIX 2018 standards
CONFIG_STD_C17=y

# Enforce MISRA C standards
CONFIG_MISRA_SANE=y

# Enable FPU & FPU sharing
CONFIG_FPU=y
CONFIG_FPU_SHARING=y

# Reset Reason and Reboot
CONFIG_HWINFO=y
CONFIG_REBOOT=y

# Power Management
CONFIG_PM_DEVICE=y

# Compiler optimizations
# Optimize for speed since space isn't a huge concern for this app
CONFIG_SPEED_OPTIMIZATIONS=y

# Flash operations.
CONFIG_FLASH=y
CONFIG_FLASH_MAP=y
CONFIG_FLASH_PAGE_LAYOUT=y
CONFIG_STREAM_FLASH=y
CONFIG_SETTINGS=y

# Watchdog timer
CONFIG_WATCHDOG=y
CONFIG_WDT_DISABLE_AT_BOOT=n

# Multiplexor drivers
CONFIG_GPIO=y
CONFIG_MULTIPLEXER=y

# I2C
CONFIG_I2C=y

# PWM
CONFIG_PWM=y

# Networking
CONFIG_NETWORKING=y
CONFIG_NET_BUF=y
CONFIG_NET_SOCKETS=y
CONFIG_NET_IPV4=y
CONFIG_NET_IPV6=y
CONFIG_NET_UDP=n

# Stack and heap configurations
# Main's stack has two big, SEQUENTIAL (never nested) consumers per
# update_stop pass: the Swiftly native-TLS/mbedTLS request frames, then
# parse_swiftly_json's jsmn token array. History matters here: 12288
# overflowed on real hardware (2026-08-01) when the token array was 742
# x 16B = ~11.9KB; 16384 then MEASURED 12764 peak via the thread
# analyzer (2026-08-08 bench watermark run). The RAM diet packed
# jsmntok_t to 8B AND raised the budget to the 934-token max shape
# (parse_swiftly.c) -- the parse local is now 7472B, projecting the peak
# to ~8.4K; 12288 gives ~45% margin over that projection and was
# re-verified green on hardware post-diet. MPU_STACK_GUARD stays the
# loud backstop. Do NOT grow STOP_TOK_COUNT/STOP_MAX_ROUTES or unpack
# jsmntok_t without redoing this arithmetic.
CONFIG_MAIN_STACK_SIZE=12288
# Increase heap size for networking operations
CONFIG_HEAP_MEM_POOL_SIZE=4096

# MCUBOOT
CONFIG_BOOTLOADER_MCUBOOT=y
CONFIG_MCUBOOT_BOOTUTIL_LIB=y

# Enable MCUmgr and dependencies.
CONFIG_ZCBOR=y
CONFIG_MCUMGR=y
CONFIG_BASE64=y
CONFIG_CRC=y
CONFIG_CONSOLE=y
CONFIG_UART_CONSOLE=y
CONFIG_UART_CONSOLE_MCUMGR=y
CONFIG_UART_MCUMGR=y
CONFIG_MCUMGR_TRANSPORT_UART=y

# 256 (was 512 'for transfer speeds'): newtmgr uploads are the legacy
# path now that FOTA is verified; slower serial DFU beats 256B of
# permanent RAM.
CONFIG_UART_MCUMGR_RX_BUF_SIZE=256
CONFIG_MCUMGR_TRANSPORT_NETBUF_SIZE=512

# Sysworkq's biggest real user is the pigeon dictionary-log flush POST
# (http_client over a modem-TLS socket); measured peak 2096 of 4096
# (2026-08-08 thread-analyzer watermarks). 3072 keeps ~1KB margin.
# MCUmgr handlers run on their own transport workqueue, not here.
CONFIG_SYSTEM_WORKQUEUE_STACK_SIZE=3072

# Enable most MCUmgr core commands.
CONFIG_IMG_MANAGER=y
CONFIG_IMG_ERASE_PROGRESSIVELY=y
CONFIG_MCUMGR_GRP_IMG=y
CONFIG_MCUMGR_GRP_OS=y
CONFIG_IMG_ENABLE_IMAGE_CHECK=y

# Hardening
CONFIG_FORTIFY_SOURCE_COMPILE_TIME=y
CONFIG_STACK_SENTINEL=y
CONFIG_OVERRIDE_FRAME_POINTER_DEFAULT=y
CONFIG_STACK_CANARIES=y
CONFIG_STACK_POINTER_RANDOM=100

# NCS boot banner
CONFIG_NCS_APPLICATION_BOOT_BANNER_STRING="Embedded Departure Board"

# Logging
CONFIG_LOG=y
# 1 = Error, 2 = Warn, 3 = Info, 4 = Debug
CONFIG_LOG_DEFAULT_LEVEL=2

# Deferred mode (was minimal): CONFIG_PIGEON_LOG_UPLOAD's dictionary backend
# is a real log backend, and minimal mode never dispatches to backends at
# all -- the ring buffer would simply stay empty. The UART console backend
# still renders human-readable text in deferred mode (dictionary encoding is
# per-backend, not global), it's just flushed asynchronously by the log
# processing thread. That thread only runs at all because main's loop now
# sleeps between passes instead of k_cpu_idle()ing (see main.c).
CONFIG_LOG_MODE_DEFERRED=y
# Measured 696 peak of 1536 (2026-08-08 watermarks) at this WRN-level
# volume; 1024 keeps ~47% margin. Revisit together with any
# LOG_DEFAULT_LEVEL bump (higher levels mean bigger formatting frames).
CONFIG_LOG_PROCESS_THREAD_STACK_SIZE=1024
# Deferred-mode core message buffer; WRN-level volume never came close
# to filling the 1024 default.
CONFIG_LOG_BUFFER_SIZE=768
# Measured 440 peak of 2048 (2026-08-08 watermarks); the ISR population
# here (UARTE/RTC/GPIO/IPC) nests shallowly. 1024 is 2.3x the measured
# peak.
CONFIG_ISR_STACK_SIZE=1024

# Log RTT
# CONFIG_LOG_BACKEND_UART=n
# CONFIG_LOG_MODE_MINIMAL=n
# CONFIG_USE_SEGGER_RTT=y
# CONFIG_LOG_BACKEND_RTT=y
# CONFIG_SEGGER_RTT_MODE_NO_BLOCK_TRIM=y

# Network Logging
# CONFIG_NET_LOG=y
# CONFIG_NET_SOCKETS_LOG_LEVEL_DBG=y

# Debugging
CONFIG_DEBUG=y
CONFIG_FAULT_DUMP=2
# CONFIG_DEBUG_COREDUMP=y
# CONFIG_DEBUG_COREDUMP_BACKEND_LOGGING=y
# CONFIG_DEBUG_COREDUMP_MEMORY_DUMP_MIN=y
# CONFIG_DEBUG_OPTIMIZATIONS=y
# CONFIG_THREAD_NAME=y
# CONFIG_THREAD_MONITOR=y
# CONFIG_THREAD_ANALYZER=y
# CONFIG_THREAD_ANALYZER_USE_LOG=y
# CONFIG_THREAD_ANALYZER_USE_PRINTK=y
# CONFIG_THREAD_ANALYZER_AUTO=y
# CONFIG_THREAD_ANALYZER_AUTO_INTERVAL=5
# CONFIG_DEBUG_THREAD_INFO=y
# CONFIG_THREAD_STACK_INFO=y
# CONFIG_MULTIPLEXER_LOG_LEVEL_DBG=y

# CONFIG_SYS_HEAP_LISTENER=y
# CONFIG_SYS_HEAP_RUNTIME_STATS=y
# CONFIG_STACK_USAGE=y
# CONFIG_INIT_STACKS=y

# Pigeon (PidgeIoT device management, see app/west.yml + net/pigeon_client.c)
# HTTPS connector: this sign's day job (the Swiftly fetch loop) is already
# plain HTTPS over the same LTE link, so no protocol/socket-type conflict.
# CONFIG_PIGEON_ENDPOINT/CONFIG_PIGEON_TOKEN are real device secrets --
# supplied via the gitignored prj.local.conf (see this file's CMakeLists.txt
# handling), never committed here.
CONFIG_PIGEON=y
CONFIG_PIGEON_CONNECTOR_HTTPS=y
# Sec tag 2: 0=NO_SEC_TAG, 1=SWIFTLY_SEC_TAG (see net/lte_manager.h's enum
# tls_sec_tags) -- the CA cert provisioned under it is GTS Root R4
# (net/lte_manager.c), since api.pidgeiot.com sits behind the Google Trust
# Services chain. Provisioned into the MODEM's credential store
# (CONFIG_MODEM_KEY_MGMT, board conf): pigeon's sockets are plain offloaded
# IPPROTO_TLS_1_2, so their TLS runs inside the modem -- deliberately NOT
# sharing Swiftly's native mbedTLS path, whose 40KB heap is sized for one
# connection at a time (board conf) and would make concurrent pigeon and
# Swiftly handshakes fight over it.
CONFIG_PIGEON_HTTPS_SEC_TAG=2
# The full runtime-tunable target_config (stop_id, three interval/retry
# knobs, the 6-entry "displays" route layout, plus a firmware target)
# outgrows the pigeon library's 320-byte default config cap -- an over-cap
# config truncates mid-JSON and fails the parse, it doesn't degrade. 768
# fits the worst-case ack (~130B scalars + ~175B displays + ~140B firmware
# = ~445B) with ample headroom -- headroom that is NOT free to reclaim:
# incoming target_configs still carry keys this firmware no longer decodes
# (the retired ntp_* set) until the fleet's shadows are re-pushed, and the
# cap bounds that incoming text too. The library's receive buffers scale
# off this (~2.5x across two static buffers), paid for by the offsets
# below (FOTA chunk, log buffers).
CONFIG_PIGEON_SHADOW_CONFIG_MAX=768
CONFIG_PIGEON_LOG_LEVEL=4
# Back to the library default 8 slots (was pinned to 4 during the
# RAM-starved era): this app stages 4 keys today, and the diet bought
# back the ~1.3KB of headroom so new keys (e.g. occupancy metrics) don't
# require a sizing dance.
CONFIG_PIGEON_TELEMETRY_MAX_KEYS=8
# Remote dictionary logs (task #2): Zephyr dictionary-encoded records ring-
# buffered in the pigeon module and POSTed to <endpoint>/logs. Decoding
# needs this build's log_dictionary.json artifact -- see the README bench
# section. 5min max flush interval matches the poll cadence's LTE budget;
# the 256B batch threshold flushes sooner under bursts. Ring + flush buffer
# cost 2x BUF_SIZE of static RAM; at the WRN default level 512 holds a
# healthy burst (~10 dictionary records), and this build is RAM-bound.
CONFIG_PIGEON_LOG_UPLOAD=y
CONFIG_PIGEON_LOG_UPLOAD_BUF_SIZE=256
CONFIG_PIGEON_LOG_UPLOAD_BATCH_SIZE=128
CONFIG_PIGEON_LOG_UPLOAD_MAX_INTERVAL_MS=300000
# FOTA (task #3): shadow "firmware" target -> chunked, device-authed Range
# download straight into the external-flash MCUboot secondary slot (slot1 on
# the w25q32jv, board overlay) -> streamed sha256 verify -> one-time test
# swap -> graceful reboot. The image confirms itself only after its first
# successful departure fetch (fota.c confirm_image_if_healthy); until then
# MCUboot reverts on reset -- that's the anti-brick net, not a bug.
CONFIG_PIGEON_FOTA=y
# NCS dfu_target backend: the exact write/schedule path hardware-verified on
# real nRF9160 (pigeon tasks #23-24); pigeon's vendor-neutral default has no
# hardware pass yet. This is an NCS workspace, so the dependency is free.
CONFIG_PIGEON_FOTA_NCS=y
# DFU_TARGET drags its nRF91 modem-delta backend in by default; this sign
# only ever updates its application image.
CONFIG_DFU_TARGET_MODEM_DELTA=n
# 512 quarters the static buffer cost (chunk + dfu staging) vs the 2048
# default in this RAM-bound image -- the second halving (1024 -> 512,
# 2026-08-02) funds the SHADOW_CONFIG_MAX bump for the "displays" key.
# Price: ~4x the Range requests of the default (~500 for a ~250KB image,
# roughly 6-12 min on LTE-M with modem-TLS session reuse). Never raise
# past 2048 on this board: pigeon rides modem TLS here, and oversized
# responses hit the same modem recv limitation that pushed Swiftly off
# modem TLS (git 2639259).
CONFIG_PIGEON_FOTA_CHUNK_SIZE=512
# 100ms between FOTA chunks: opens periodic airtime windows so the day
# job's Swiftly fetch isn't starved for the whole download (the failure
# that burned all three attempts of the first live OTA test) -- costs
# ~95s on a ~949-chunk image. Pairs with main.c's bounded reset-policy
# suppression; see pigeon_client_fota_active().
CONFIG_PIGEON_FOTA_CHUNK_YIELD_MS=100
# CONFIG_PIGEON_FOTA_CURRENT_VERSION is NOT set here on purpose: it is
# derived from app/VERSION by CMakeLists.txt so it can never drift from the
# image's real version.
# CONFIG_PIGEON_REBOOT_ON_FATAL/_WATCHDOG deliberately NOT enabled here --
# see prj_release.conf's comment: this is the dev/debug profile, and
# pigeon's own Kconfig help explicitly recommends leaving reboot-on-fatal
# off while actively debugging on a dev board.
```

## app.conf
```kconfig
CONFIG_STOP_ID="1670"

# Stop data request options
CONFIG_STOP_REQUEST_INFOPOINT=y
CONFIG_STOP_REQUEST_HOSTNAME="bustracker.pvta.com"
# CONFIG_STOP_REQUEST_HOSTNAME="pvta.jes.contact"

CONFIG_STOP_REQUEST_PATH="/InfoPoint/rest/SignageStopDepartures/GetSignageDeparturesByStopId?stopId=1670"
# CONFIG_STOP_REQUEST_PATH="/stop/1670"

# Defines the max size for JSON response body receive buffer.
# Actual size required varies quite a bit depending on how many routes
# are currently running for a given stop.
CONFIG_STOP_JSON_BUF_SIZE=14336

# OTA DFU options
CONFIG_OTA_HOSTNAME="pvta.jes.contact"
CONFIG_OTA_PATH="/firmware"

# Set to 'y' to enable I2C ambient light sensor
CONFIG_LIGHT_SENSOR=y

# Set to 'y' to run visiual display tests
CONFIG_LED_DISPLAY_TEST=n
```

## prj.example.conf
```kconfig
# Copy this file to app/prj.local.conf and fill in the values for the sign being
# built. prj.local.conf is untracked: which stop a sign serves, and whose
# predictions API it reads, are properties of a deployment rather than of this
# source tree.
#
# It is merged after prj.conf and sign.conf, so anything set here wins.

# The stop this sign serves, as the predictions API identifies it.
CONFIG_STOP_ID="00000"

# The predictions API path for the transit agency being queried. The hostname is
# CONFIG_SWIFTLY_API_HOSTNAME in app/Kconfig; only the path is agency specific.
CONFIG_SWIFTLY_API_PATH="/real-time/example-agency/predictions"

# Optional. Naming the sign in the boot banner makes a console session say which
# board it is attached to.
# CONFIG_NCS_APPLICATION_BOOT_BANNER_STRING="Embedded Departure Board Example"
```

## prj_release.conf
```kconfig
# See prj.conf's comment: TFM_EXPERIMENTAL is unconditionally enabled by this
# TF-M profile on this SoC, reproduced on a stock hello_world -- not this
# app's fault, but fatal under this project's strict Kconfig-warnings policy.
CONFIG_WARN_EXPERIMENTAL=n

# Set LIBC
CONFIG_PICOLIBC=y

# PicolibC targets C17 and POSIX 2018 standards
CONFIG_STD_C17=y

# Enforce MISRA C standards
CONFIG_MISRA_SANE=y

# Enable FPU & FPU sharing
CONFIG_FPU=y
CONFIG_FPU_SHARING=y

# Reset Reason and Reboot
CONFIG_HWINFO=y
CONFIG_REBOOT=y

# Power Management
CONFIG_PM_DEVICE=y

# Compiler optimizations
# Optimize for speed since space isn't a huge concern for this app
CONFIG_SPEED_OPTIMIZATIONS=y

# Flash operations.
CONFIG_FLASH=y
CONFIG_FLASH_MAP=y
CONFIG_FLASH_PAGE_LAYOUT=y
CONFIG_STREAM_FLASH=y
CONFIG_SETTINGS=y

# Watchdog timer
CONFIG_WATCHDOG=y
CONFIG_WDT_DISABLE_AT_BOOT=n

# Multiplexor drivers
CONFIG_GPIO=y
CONFIG_MULTIPLEXER=y

# I2C
CONFIG_I2C=y

# PWM
CONFIG_PWM=y

# Networking
CONFIG_NETWORKING=y
CONFIG_NET_BUF=y
CONFIG_NET_SOCKETS=y
CONFIG_NET_IPV4=y
CONFIG_NET_IPV6=y
CONFIG_NET_UDP=n

# Stack and heap configurations
# Main's stack has two big, SEQUENTIAL (never nested) consumers per
# update_stop pass: the Swiftly native-TLS/mbedTLS request frames, then
# parse_swiftly_json's jsmn token array. History matters here: 12288
# overflowed on real hardware (2026-08-01) when the token array was 742
# x 16B = ~11.9KB; 16384 then MEASURED 12764 peak via the thread
# analyzer (2026-08-08 bench watermark run). The RAM diet packed
# jsmntok_t to 8B AND raised the budget to the 934-token max shape
# (parse_swiftly.c) -- the parse local is now 7472B, projecting the peak
# to ~8.4K; 12288 gives ~45% margin over that projection and was
# re-verified green on hardware post-diet. MPU_STACK_GUARD stays the
# loud backstop. Do NOT grow STOP_TOK_COUNT/STOP_MAX_ROUTES or unpack
# jsmntok_t without redoing this arithmetic.
CONFIG_MAIN_STACK_SIZE=12288
# Increase heap size for networking operations
CONFIG_HEAP_MEM_POOL_SIZE=4096

# MCUBOOT
CONFIG_BOOTLOADER_MCUBOOT=y
CONFIG_MCUBOOT_BOOTUTIL_LIB=y

# Enable MCUmgr and dependencies.
CONFIG_ZCBOR=y
CONFIG_MCUMGR=y
CONFIG_BASE64=y
CONFIG_CRC=y
CONFIG_CONSOLE=y
CONFIG_UART_CONSOLE=y
CONFIG_UART_CONSOLE_MCUMGR=y
# Previously implied by another symbol; NCS 3.4.0 needs this set explicitly.
CONFIG_UART_MCUMGR=y
CONFIG_MCUMGR_TRANSPORT_UART=y

# 256 (was 512 'for transfer speeds'): newtmgr uploads are the legacy
# path now that FOTA is verified; slower serial DFU beats 256B of
# permanent RAM.
CONFIG_UART_MCUMGR_RX_BUF_SIZE=256
CONFIG_MCUMGR_TRANSPORT_NETBUF_SIZE=512

# Sysworkq's biggest real user is the pigeon dictionary-log flush POST
# (http_client over a modem-TLS socket); measured peak 2096 of 4096
# (2026-08-08 thread-analyzer watermarks). 3072 keeps ~1KB margin.
# MCUmgr handlers run on their own transport workqueue, not here.
CONFIG_SYSTEM_WORKQUEUE_STACK_SIZE=3072

# Enable most MCUmgr core commands.
CONFIG_IMG_MANAGER=y
CONFIG_IMG_ERASE_PROGRESSIVELY=y
CONFIG_MCUMGR_GRP_IMG=y
CONFIG_MCUMGR_GRP_OS=y
CONFIG_IMG_ENABLE_IMAGE_CHECK=y

# Hardening
CONFIG_FORTIFY_SOURCE_COMPILE_TIME=y
CONFIG_STACK_SENTINEL=y
CONFIG_OVERRIDE_FRAME_POINTER_DEFAULT=y
CONFIG_STACK_CANARIES=y
CONFIG_STACK_POINTER_RANDOM=100
CONFIG_BOOT_BANNER=n
CONFIG_BUILD_OUTPUT_STRIPPED=y
CONFIG_EARLY_CONSOLE=n
CONFIG_FAULT_DUMP=0
CONFIG_EXCEPTION_DEBUG=n
CONFIG_PRINTK=n
CONFIG_NCS_BOOT_BANNER=n

# Logging
CONFIG_LOG=y
# 1 = Error, 2 = Warn, 3 = Info, 4 = Debug
CONFIG_LOG_DEFAULT_LEVEL=2
# Deferred mode (was minimal): required for CONFIG_PIGEON_LOG_UPLOAD's
# dictionary backend to see any records -- see prj.conf's fuller comment.
CONFIG_LOG_MODE_DEFERRED=y
# Measured 696 peak of 1536 (2026-08-08 watermarks) at this WRN-level
# volume; 1024 keeps ~47% margin. Revisit together with any
# LOG_DEFAULT_LEVEL bump (higher levels mean bigger formatting frames).
CONFIG_LOG_PROCESS_THREAD_STACK_SIZE=1024
# Deferred-mode core message buffer; WRN-level volume never came close
# to filling the 1024 default.
CONFIG_LOG_BUFFER_SIZE=768
# Measured 440 peak of 2048 (2026-08-08 watermarks); the ISR population
# here (UARTE/RTC/GPIO/IPC) nests shallowly. 1024 is 2.3x the measured
# peak.
CONFIG_ISR_STACK_SIZE=1024

# Debugging
CONFIG_DEBUG=n

# Pigeon (PidgeIoT device management) -- see prj.conf's comment for the base
# HTTPS connector config, shared with this profile via the same values below.
CONFIG_PIGEON=y
CONFIG_PIGEON_CONNECTOR_HTTPS=y
CONFIG_PIGEON_HTTPS_SEC_TAG=2
# The full runtime-tunable target_config (stop_id, three interval/retry
# knobs, the 6-entry "displays" route layout, plus a firmware target)
# outgrows the pigeon library's 320-byte default config cap -- an over-cap
# config truncates mid-JSON and fails the parse, it doesn't degrade. 768
# fits the worst-case ack (~130B scalars + ~175B displays + ~140B firmware
# = ~445B) with ample headroom -- headroom that is NOT free to reclaim:
# incoming target_configs still carry keys this firmware no longer decodes
# (the retired ntp_* set) until the fleet's shadows are re-pushed, and the
# cap bounds that incoming text too. The library's receive buffers scale
# off this (~2.5x across two static buffers), paid for by the offsets
# below (FOTA chunk, log buffers).
CONFIG_PIGEON_SHADOW_CONFIG_MAX=768
# Matches this profile's own CONFIG_LOG_DEFAULT_LEVEL=2 above.
CONFIG_PIGEON_LOG_LEVEL=2
# See prj.conf's comments for both blocks below.
CONFIG_PIGEON_TELEMETRY_MAX_KEYS=8
CONFIG_PIGEON_LOG_UPLOAD=y
CONFIG_PIGEON_LOG_UPLOAD_BUF_SIZE=256
CONFIG_PIGEON_LOG_UPLOAD_BATCH_SIZE=128
CONFIG_PIGEON_LOG_UPLOAD_MAX_INTERVAL_MS=300000
# FOTA (task #3): shadow "firmware" target -> chunked, device-authed Range
# download straight into the external-flash MCUboot secondary slot (slot1 on
# the w25q32jv, board overlay) -> streamed sha256 verify -> one-time test
# swap -> graceful reboot. The image confirms itself only after its first
# successful departure fetch (fota.c confirm_image_if_healthy); until then
# MCUboot reverts on reset -- that's the anti-brick net, not a bug.
CONFIG_PIGEON_FOTA=y
# NCS dfu_target backend: the exact write/schedule path hardware-verified on
# real nRF9160 (pigeon tasks #23-24); pigeon's vendor-neutral default has no
# hardware pass yet. This is an NCS workspace, so the dependency is free.
CONFIG_PIGEON_FOTA_NCS=y
# DFU_TARGET drags its nRF91 modem-delta backend in by default; this sign
# only ever updates its application image.
CONFIG_DFU_TARGET_MODEM_DELTA=n
# 512 quarters the static buffer cost (chunk + dfu staging) vs the 2048
# default in this RAM-bound image -- the second halving (1024 -> 512,
# 2026-08-02) funds the SHADOW_CONFIG_MAX bump for the "displays" key.
# Price: ~4x the Range requests of the default (~500 for a ~250KB image,
# roughly 6-12 min on LTE-M with modem-TLS session reuse). Never raise
# past 2048 on this board: pigeon rides modem TLS here, and oversized
# responses hit the same modem recv limitation that pushed Swiftly off
# modem TLS (git 2639259).
CONFIG_PIGEON_FOTA_CHUNK_SIZE=512
# 100ms between FOTA chunks: opens periodic airtime windows so the day
# job's Swiftly fetch isn't starved for the whole download (the failure
# that burned all three attempts of the first live OTA test) -- costs
# ~95s on a ~949-chunk image. Pairs with main.c's bounded reset-policy
# suppression; see pigeon_client_fota_active().
CONFIG_PIGEON_FOTA_CHUNK_YIELD_MS=100
# CONFIG_PIGEON_FOTA_CURRENT_VERSION is NOT set here on purpose: it is
# derived from app/VERSION by CMakeLists.txt so it can never drift from the
# image's real version.
# Task #45's wedge-recovery pair, appropriate for a field-deployed sign with
# no operator console (unlike prj.conf's dev-profile build, which leaves
# these off per pigeon's own Kconfig help). This REPLACES the previous
# CONFIG_RESET_ON_FATAL_ERROR=y (nrf/lib/fatal_error) -- both define a
# strong, non-weak k_sys_fatal_error_handler(), so only one can be linked in;
# pigeon's is the standard mitigation shared across every PidgeIoT-managed
# device, so this project adopts it in place of NCS's own equivalent rather
# than fighting the two for one symbol slot.
CONFIG_PIGEON_REBOOT_ON_FATAL=y
# CONFIG_PIGEON_WATCHDOG stays OFF: this board's watchdog0 devicetree alias
# is the same physical wdt0 peripheral watchdog_app.c already owns end-to-end
# (wdt_install_timeout/wdt_setup, fed throughout main.c's loop), and the two
# cannot share it. Traced through the vendored sources rather than assumed:
# watchdog_init() runs before pigeon_client_init() in main(), so by the time
# pigeon_watchdog_start() calls task_wdt_init(wdt0), wdt_nrf_install_timeout()
# (zephyr/drivers/watchdog/wdt_nrfx.c) sees data->enabled and returns -EBUSY;
# task_wdt_init() then bails BEFORE arming even its software timer, so with =y
# pigeon's watchdog is deterministically inert -- no software channel either,
# just a task_wdt_init-failed error logged every boot. Worse, if init order
# ever flipped, task_wdt_add() would wdt_setup() a ~300ms-window channel first
# and watchdog_app.c's own install would -EBUSY into main()'s `goto reset` --
# a boot loop. The app's proven hardware watchdog covers the liveness-stall
# shape; CONFIG_PIGEON_REBOOT_ON_FATAL above covers the fatal-error shape.
CONFIG_PIGEON_WATCHDOG=n
```

## sign.conf
```kconfig
# Stop settings
# CONFIG_STOP_ID comes from the untracked app/prj.local.conf; see the README.
CONFIG_STOP_MAX_ROUTES=8
CONFIG_ROUTE_MAX_DEPARTURES=3

# Display settings
# Adjust DISPLAY_BOXES display settings in app/src/update_stop.h
CONFIG_NUMBER_OF_DISPLAY_BOXES=6

# We occasionally get an EAGAIN error on socket connect to the Swiftly endpoint.
CONFIG_HTTP_REQUEST_RETRY_COUNT=1

# Defines the max size for JSON response body receive buffer.
# Actual size required varies quite a bit depending on how many routes
# are currently running for a given stop.
CONFIG_STOP_JSON_BUF_SIZE=8192

# Set to 'n' to disable I2C ambient light sensor
# CONFIG_LIGHT_SENSOR=n

# Set to 'y' to run visual display tests
# CONFIG_LED_DISPLAY_TEST=y
```

## soak_verbose.conf
```kconfig
# Raised-verbosity overlay for a soak whose job is to explain a hang.
#
# Layered on top of prj_release.conf rather than edited into it, so a release
# build cannot pick it up by accident:
#
#   west build --sysbuild ./app -b circuitdojo_feather/nrf9160/ns -d <dir> -- \
#     -DFILE_SUFFIX=release \
#     -Dapp_EXTRA_CONF_FILE=<abs path to this file>
#
# Nothing outside the logging pipeline changes. The release profile's WRN
# floor compiles INFO out entirely, which makes the silence before a watchdog
# reset uninformative: there is no way to tell where the loop stopped because
# there was nothing it could have printed. INFO restores a per-cycle
# breadcrumb trail (request sent, response code, bytes received, tokens
# parsed, routes matched, display writes, lux, PWM) so the last line before a
# hang names the phase it hung in.

# 1 = Error, 2 = Warn, 3 = Info, 4 = Debug
CONFIG_LOG_DEFAULT_LEVEL=3
CONFIG_PIGEON_LOG_LEVEL=3

# DEBUG is deliberately not enabled anywhere. The three suspects were each
# checked against their actual call sites: watchdog and lte_manager have no
# LOG_DBG at all, so level 4 buys nothing there; main's two LOG_DBG sites sit
# inside the 100ms loop pass and would emit ~10 records/s, three orders of
# magnitude over the whole INFO budget below; custom_http_client's would dump
# both header buffers in full on every request. INFO already brackets the
# request path closely enough to say which phase stopped.

# Sized for the INFO burst, not the WRN trickle: one update_stop pass emits
# roughly 17 records back to back (one per route, one per matched display,
# plus the HTTP and display lines) while main holds the CPU, and in deferred
# mode they all sit here until the log thread runs. The former 768 left no
# room for that burst plus whatever is already in flight.
CONFIG_LOG_BUFFER_SIZE=2048
# Bigger formatting frames come with the higher level; the former 1024 was
# measured against WRN-level volume only.
CONFIG_LOG_PROCESS_THREAD_STACK_SIZE=2048

# The upload ring has to be resized with the floor or the instrumentation
# becomes the experiment. INFO produces ~19 B/s of dictionary records; against
# the former 256-byte ring and 128-byte batch threshold that is a flush every
# ~7s, i.e. a continuous run of HTTPS POSTs contending for the same pigeon
# transport lock this soak is meant to observe, and dropping most of the
# records anyway. 2048/1536 puts a flush at roughly 80s and keeps the batch
# whole. Costs 2x the ring size in RAM (the flush buffer is a static of the
# same size); the image has ~12.8KB of SRAM headroom.
CONFIG_PIGEON_LOG_UPLOAD_BUF_SIZE=2048
CONFIG_PIGEON_LOG_UPLOAD_BATCH_SIZE=1536
```

## boards/circuitdojo_feather_nrf9160_ns.conf
```kconfig
# Hardening
CONFIG_STACK_SENTINEL=n
CONFIG_HW_STACK_PROTECTION=y
CONFIG_MPU_STACK_GUARD=y

# External SPI Flash (MCUboot secondary slot lives here -- see this board's
# overlay for the devicetree partition nodes; no Partition Manager needed)
CONFIG_NVS=y
CONFIG_SETTINGS_NVS=y
CONFIG_SPI_NOR=y
CONFIG_SPI_NOR_FLASH_LAYOUT_PAGE_SIZE=4096

# Allow writing to the flash at runtime
CONFIG_MPU_ALLOW_FLASH_WRITE=y

# Neopixels over SPI
CONFIG_SPI=y
CONFIG_LED_STRIP=y

# NRF Modem configurations
CONFIG_NRF_MODEM_LIB=y
CONFIG_NRF_MODEM_LIB_FAULT_STRERROR=y
CONFIG_NRF_MODEM_LIB_ON_FAULT_APPLICATION_SPECIFIC=y
# =y since the pigeon integration moved to modem TLS: lte_manager.c
# provisions ONLY the pigeon CA cert into the modem store with this
# (pre-registration, compare-before-write). Swiftly's cert and socket stay
# on native TLS/the native store regardless -- custom_http_client.c no
# longer keys its socket type off this symbol.
CONFIG_MODEM_KEY_MGMT=y

# Poll entries per poll() call: one per modem socket, so any caller can poll
# every offloaded socket at once.
CONFIG_ZVFS_POLL_MAX=8

# Occasionally the TLS setup take a long time and we don't want to reset just for that
CONFIG_NET_SOCKETS_CONNECT_TIMEOUT=30000

# NRF LTE link control library
CONFIG_LTE_LINK_CONTROL=y

# LTE-M only (%XSYSTEMMODE=1,0,0,0), replacing the Kconfig default of
# LTE-M + NB-IoT + GPS. GPS: this app has zero GNSS use (no fix code, no
# antenna provision on the sign). NB-IoT: effectively sunset on US
# carriers, and a 30s HTTPS fetch cadence with multi-KB payloads is the
# wrong shape for it anyway -- a fallback registration onto NB-IoT would
# degrade the day job, not save it. Dropping both also shrinks the
# carrier-scan space the modem walks on every reacquisition after a
# coverage blip.
CONFIG_LTE_NETWORK_MODE_LTE_M=y

# LTE Power Saving Mode
CONFIG_LTE_LC_PSM_MODULE=y
CONFIG_LTE_PSM_REQ=y
# Request periodic TAU of 12 hours (T3412 ext: unit 001 = 1h, value
# 01100 = 12). Near-moot at this sign's cadence -- T3412 restarts on
# every return to idle, and the sign connects every 30s, so periodic TAU
# never actually fires -- but 12h is the right request for the battery
# products this config generalizes to.
CONFIG_LTE_PSM_REQ_RPTAU="00101100"
# Requested Active Time (T3324) ZERO, was 10s: every byte this device
# ever moves is mobile-originated (HTTPS fetch/poll, telemetry POST,
# FOTA pull -- no server push of any kind, no WS connector on this
# board), so a paging window after RRC release protects nothing. T3324=0
# drops the modem straight from RRC idle into PSM floor current instead
# of paying up to 10s of idle-DRX paging first. MO traffic exits PSM via
# a plain service request at any moment -- the next fetch neither knows
# nor cares that the modem was in PSM. Granted-vs-requested is carrier
# discretion; verify on bench (README, LTE power section).
CONFIG_LTE_PSM_REQ_RAT="00000000"

# eDRX: pure fallback for carriers that deny PSM -- when PSM is granted
# with T3324=0 (above) there are no idle paging occasions left for eDRX
# to stretch. An MO-only device is indifferent to paging latency, so
# request the longest WB-S1 cycle (1101 = 2621.44s; 1110/1111 are
# NB-IoT-only) and let a PSM-less network idle at ~44min paging instead
# of the ~1.28s default DRX. PTW deliberately not requested -- the
# lte_link_control Kconfig help itself says to let the modem pick.
CONFIG_LTE_LC_EDRX_MODULE=y
CONFIG_LTE_EDRX_REQ=y
CONFIG_LTE_EDRX_REQ_VALUE_LTE_M="1101"

# AS-RAI: a 30s-cadence client that never signals end-of-data pays the
# carrier's full ~10-20s RRC inactivity tail in connected mode after
# every single fetch -- more airtime than the fetch itself. With this on,
# lte_link_control arms the feature at modem init (AT%RAI=2, falling
# back to =1 on older mfw -- rai.c) and custom_http_client.c asserts the
# per-socket SO_RAI end-of-data hint after each completed response; see
# the ordering rationale there. Requires network-side AS-RAI (Rel-14);
# where the network lacks it the hint is inert and behavior is exactly
# as before.
CONFIG_LTE_LC_RAI_MODULE=y
CONFIG_LTE_RAI_REQ=y

# NRF net configurations
CONFIG_NET_NATIVE=n
CONFIG_NET_SOCKETS_OFFLOAD=y
CONFIG_NET_SOCKETS_SOCKOPT_TLS=y
# Disable Duplicate Address Detection (DAD), not properly implemented for offloaded interfaces
CONFIG_NET_IPV6_NBR_CACHE=n
CONFIG_NET_IPV6_MLD=n

# TF-M configurations
CONFIG_BUILD_WITH_TFM=y
CONFIG_TFM_PROFILE_TYPE_NOT_SET=y
CONFIG_TFM_CMAKE_BUILD_TYPE_RELEASE=y

# TF-M logging requirements
CONFIG_TFM_SECURE_UART0=y
CONFIG_TFM_SECURE_UART_SHARE_INSTANCE=y

# All crypto runs in TF-M, which stages every PSA call's input and output in
# this scratch buffer. It must fit our largest call: decrypting a full 16 KB
# TLS record (~16.4 KB in + ~16.4 KB out).
CONFIG_TFM_CRYPTO_IOVEC_BUFFER_SIZE=36864

# Wanting RSA >= 3072 flips this default to 0x4000, which does not fit TF-M's
# SRAM region. This build only VERIFIES RSA (PKCS1v15, e=65537 -- no sign, no
# keygen), which runs within the pre-RSA stack.
CONFIG_TFM_CRYPTO_PARTITION_STACK_SIZE=0x2000

# The CryptoCell blob rejects TLS 1.2 ECDHE key agreement; use Oberon instead.
# ECDHE runs once per connection, so software speed is fine.
CONFIG_PSA_USE_CC3XX_KEY_AGREEMENT_DRIVER=n

# Crypto drivers
CONFIG_PSA_CRYPTO_DRIVER_CC3XX=y

# Enable MbedTLS
CONFIG_MBEDTLS=y

# MbedTLS configurations
CONFIG_MBEDTLS_ENABLE_HEAP=y
## Crypto runs in TF-M, so this heap only holds the SSL I/O buffers, X509
## parsing, and session state for one TLS connection at a time (Swiftly is
## the only mbedTLS consumer; pigeon rides modem TLS). Peak model: 16.6K IN
## + 2.2K OUT record buffers + the five parsed trust-store roots ~5.5K + a
## served chain up to ~5K, held parsed AND as its raw copy ~10K, + ssl/
## handshake transients ~5K = ~39K. The served chain is the SERVER's
## choice, so the peak is not bounded by our own store; an over-budget
## chain fails that fetch (a raw PSA -141 surfacing as connect() 113, no
## corruption) -- bump this first if Swiftly TLS ever starts failing that
## way.
CONFIG_MBEDTLS_HEAP_SIZE=40960
## Servers pick their own record size, so IN must stay at the TLS maximum.
## OUT only ever carries our small request headers and handshake flights
## (under 300 B, looping on partial writes), and its buffer is heap the
## peer-chain parse needs more.
CONFIG_MBEDTLS_SSL_IN_CONTENT_LEN=16384
CONFIG_MBEDTLS_SSL_OUT_CONTENT_LEN=2048

# MbedTLS net configurations
# One native-TLS socket ever exists (the Swiftly fetch; pigeon and FOTA ride
# modem TLS). Two slots cover teardown/reopen overlap; each slot's size
# scales with the enabled crypto, so spares are not free.
CONFIG_NET_SOCKETS_TLS_MAX_CONTEXTS=2
CONFIG_TLS_MAX_CREDENTIALS_NUMBER=8
CONFIG_NET_SOCKETS_TLS_MAX_CREDENTIALS=8

# Enable TLS credentials management subsystem
CONFIG_TLS_CREDENTIALS=y
# Volatile backend: the store is rebuilt from this image's rodata every boot,
# so the trust set always matches the firmware. The protected-storage backend
# persists the first-ever credential and add() treats -EEXIST as success,
# which would pin a FOTA'd device to the anchors it shipped with; its 2KB
# per-asset cap also cannot hold the multi-root bundle. Public CA certs need
# no secrecy or persistence beyond the signed image's own -- revisit before
# storing any actual secret here.
CONFIG_TLS_CREDENTIALS_BACKEND_VOLATILE=y

# MbedTLS module configurations
CONFIG_MBEDTLS_PK_C=y
CONFIG_MBEDTLS_PK_PARSE_C=y

CONFIG_MBEDTLS_SSL_SRV_C=n
CONFIG_MBEDTLS_TLS_VERSION_1_2=n
CONFIG_MBEDTLS_CCM_C=n
CONFIG_MBEDTLS_HMAC_DRBG_C=n
CONFIG_MBEDTLS_CIPHER_MODE_CBC=n
CONFIG_MBEDTLS_CIPHER_MODE_CTR=n

# Key exchange configurations
CONFIG_MBEDTLS_KEY_EXCHANGE_ECDHE_ECDSA_ENABLED=y
# RSA leaf chains (Amazon roots 1/2, Starfield G2) need the ECDHE_RSA suite.
CONFIG_MBEDTLS_KEY_EXCHANGE_ECDHE_RSA_ENABLED=y

# Buffer-sizing workaround, no PSK is used: PSA-only builds shrink the TLS 1.2
# premaster buffer to 1 byte (dummy MBEDTLS_ECP_MAX_BITS), breaking ECDHE.
# PSK adds a 68-byte union member that fits the P-256 shared secret.
CONFIG_MBEDTLS_KEY_EXCHANGE_PSK_ENABLED=y
CONFIG_MBEDTLS_KEY_EXCHANGE_ECDHE_PSK_ENABLED=n

# Key type configurations
CONFIG_PSA_WANT_KEY_TYPE_AES=y
CONFIG_PSA_WANT_KEY_TYPE_ECC_PUBLIC_KEY=y
CONFIG_PSA_WANT_KEY_TYPE_ECC_KEY_PAIR_IMPORT=y
CONFIG_PSA_WANT_KEY_TYPE_ECC_KEY_PAIR_EXPORT=y
CONFIG_PSA_WANT_KEY_TYPE_ECC_KEY_PAIR_DERIVE=y
CONFIG_PSA_WANT_KEY_TYPE_ECC_KEY_PAIR_GENERATE=y
# RSA public keys for X.509 chain verification. KEY_PAIR_IMPORT drives the
# promptless KEY_PAIR_BASIC gate the ECDHE_RSA suite depends on.
CONFIG_PSA_WANT_KEY_TYPE_RSA_PUBLIC_KEY=y
CONFIG_PSA_WANT_KEY_TYPE_RSA_KEY_PAIR_IMPORT=y

# Cipher configurations
CONFIG_PSA_WANT_ALG_CTR=y

CONFIG_PSA_WANT_ALG_CBC_NO_PADDING=n

# Key agreement configurations
CONFIG_PSA_WANT_ALG_ECDH=y

# Key derivation function configurations
# The TLS 1.2 master-secret PRF is a PSA operation; every handshake needs it.
CONFIG_PSA_WANT_ALG_TLS12_PRF=y
CONFIG_PSA_WANT_ALG_TLS12_PSK_TO_MS=n

# MAC configurations
CONFIG_PSA_WANT_ALG_HMAC=y

# AEAD configurations
CONFIG_PSA_WANT_ALG_GCM=y

# Asymmetric signature configurations
CONFIG_PSA_WANT_ALG_ECDSA=y
CONFIG_PSA_WANT_ALG_SHA_256=y
CONFIG_PSA_WANT_ALG_RSA_PKCS1V15_SIGN=y
CONFIG_PSA_WANT_ALG_SHA_384=y
# Root CA 2 is RSA-4096; chains under it verify against that key size.
CONFIG_PSA_WANT_RSA_KEY_SIZE_2048=y
CONFIG_PSA_WANT_RSA_KEY_SIZE_4096=y

# ECC curve configurations
CONFIG_PSA_WANT_ECC_SECP_R1_256=y
CONFIG_PSA_WANT_ECC_SECP_R1_384=y

# RNG configurations
CONFIG_PSA_WANT_ALG_CTR_DRBG=y

# The trust store is a concatenated multi-root bundle; mbedTLS cannot parse
# concatenated DER in one credential, so the bundle is PEM.
CONFIG_MBEDTLS_PEM_PARSE_C=y

# Enable SNI
CONFIG_MBEDTLS_X509_CRT_PARSE_C=y
CONFIG_MBEDTLS_SSL_SERVER_NAME_INDICATION=y

# Enable SSL renegotiation
CONFIG_MBEDTLS_SSL_RENEGOTIATION=y

# Enable SSL session tickets
CONFIG_MBEDTLS_SSL_SESSION_TICKETS=y

# Enable Mbed TLS logs
CONFIG_MBEDTLS_DEBUG=y
CONFIG_MBEDTLS_DEBUG_C=y
# CONFIG_MBEDTLS_DEBUG_LEVEL=1
CONFIG_MBEDTLS_LOG_LEVEL_DBG=y
CONFIG_MBEDTLS_SSL_DEBUG_ALL=y

# Debugging
CONFIG_TLS_CREDENTIALS_LOG_LEVEL_DBG=y
# CONFIG_LTE_LINK_CONTROL_LOG_LEVEL_DBG=y
# CONFIG_NRF_MODEM_LIB_LOG_LEVEL_DBG=y
# CONFIG_NRF_MODEM_LIB_MEM_DIAG=y
# CONFIG_NRF_MODEM_LIB_MEM_DIAG_ALLOC=y
# CONFIG_NRF_MODEM_LIB_MEM_DIAG_DUMP=y
# CONFIG_NRF_MODEM_LIB_MEM_DIAG_DUMP_PERIOD_MS=10000
# CONFIG_NVS_LOG_LEVEL_DBG=y
```

## src/display_boxes.example.h
```c
#ifndef DISPLAY_BOXES_EXAMPLE_H
#define DISPLAY_BOXES_EXAMPLE_H

/* Copy this file to app/src/display_boxes.local.h and replace the entries with
 * the route-to-box mapping of the sign being built. The mapping is untracked
 * for the same reason the stop id is: it describes one physical sign.
 *
 * One entry per display box, and exactly CONFIG_NUMBER_OF_DISPLAY_BOXES of
 * them. A route id is at most four characters. The direction code is the single
 * character the predictions API uses for a direction of travel. Brightness is a
 * per-box power cap chosen so that a box with every LED lit stays inside its
 * current limit, which is why it lives here and not in a shadow the platform
 * can raise.
 */

/** Specify the route id, position, direction, color, and brightness for each display box */
// clang-format off
#define DISPLAY_BOXES {                                                                          \
  { .id = "RT1",  .position = 0, .direction_code = '0', .color = 0x00FF00, .brightness = 0x45 }, \
  { .id = "RT2",  .position = 1, .direction_code = '0', .color = 0x00FF00, .brightness = 0x45 }, \
  { .id = "RT3",  .position = 2, .direction_code = '0', .color = 0x00FF00, .brightness = 0x45 }, \
  { .id = "RT4",  .position = 3, .direction_code = '0', .color = 0x00FF00, .brightness = 0x45 }, \
  { .id = "RT5",  .position = 4, .direction_code = '0', .color = 0x00FF00, .brightness = 0x45 }, \
  { .id = "RT6",  .position = 5, .direction_code = '0', .color = 0x00FF00, .brightness = 0x45 }  \
}
// clang-format on

#endif  // DISPLAY_BOXES_EXAMPLE_H
```

## src/display_map.c
```c
#include "display_map.h"

#include <string.h>
#include <zephyr/kernel.h>
#include <zephyr/logging/log.h>

#include "update_stop.h"

LOG_MODULE_REGISTER(display_map);

/* Same locking contract as stop_id.c: written by the pigeon client thread
 * (display_map_set), read by main's update_stop path (display_map_get).
 * Held only for bounded copies, never across I/O. */
static K_MUTEX_DEFINE(display_map_lock);

/* Seeded from the compile-time DISPLAY_BOXES layout at first use -- the
 * Kconfig-default fallback when the shadow never supplies a "displays"
 * key (same convention as stop_id.c/runtime_config.c). */
static struct display_map_entry map[DISPLAY_BOX_CAPACITY];
static size_t map_count;

/* Distinct from synced below: seeded only records that the compiled
 * fallback has been loaded, which happens lazily on the first read. */
static bool seeded;

/* False until display_map_set() accepts a mapping. Guarded by the same
 * lock as the table, so an observer that sees it true is also guaranteed
 * to read the accepted mapping rather than the seed. */
static bool synced;

static void seed_from_display_boxes(void) {
  static const DisplayBox defaults[] = DISPLAY_BOXES;

  for (size_t i = 0; i < ARRAY_SIZE(defaults) && i < ARRAY_SIZE(map); i++) {
    strncpy(map[i].route, defaults[i].id, sizeof(map[i].route) - 1);
    map[i].route[sizeof(map[i].route) - 1] = '\0';
    map[i].direction = defaults[i].direction_code;
    map[i].position = (uint8_t)defaults[i].position;
  }
  map_count = ARRAY_SIZE(defaults) < ARRAY_SIZE(map) ? ARRAY_SIZE(defaults) : ARRAY_SIZE(map);
  seeded = true;
}

void display_map_get(struct display_map_entry* entries, size_t* count) {
  k_mutex_lock(&display_map_lock, K_FOREVER);

  if (!seeded) {
    seed_from_display_boxes();
  }

  memcpy(entries, map, map_count * sizeof(map[0]));
  *count = map_count;
  k_mutex_unlock(&display_map_lock);
}

void display_map_set(const struct display_map_entry* entries, size_t count) {
  if (count > ARRAY_SIZE(map)) {
    count = ARRAY_SIZE(map);
  }

  k_mutex_lock(&display_map_lock, K_FOREVER);
  memcpy(map, entries, count * sizeof(map[0]));
  map_count = count;
  seeded = true;
  synced = true;
  k_mutex_unlock(&display_map_lock);

  LOG_INF("Display map updated (%u entries)", (unsigned)count);
}

bool display_map_synced(void) {
  k_mutex_lock(&display_map_lock, K_FOREVER);
  bool s = synced;
  k_mutex_unlock(&display_map_lock);
  return s;
}
```

## src/runtime_config.c
```c
#include "runtime_config.h"

/* Written by the pigeon client thread (setter below), read by main's
 * Swiftly retry path (getter): a single aligned word with one writer, so
 * plain reads cannot tear on this core and no lock is needed. */
static int http_retry_count = CONFIG_HTTP_REQUEST_RETRY_COUNT;

int runtime_config_http_retry_count(void) { return http_retry_count; }

void runtime_config_http_retry_count_set(int value) { http_retry_count = value; }
```

## src/runtime_config.h
```c
/** @file runtime_config.h
 *  @brief Runtime-tunable operational knobs, shadow-overridable.
 *
 * Same pattern as stop_id.h, generalized: each value boots as its Kconfig
 * default and can be overwritten at runtime from the pigeon shadow's
 * target_config (net/pigeon_client.c), so a fleet operator can retune a
 * deployed sign from the dashboard without a reflash. Values persist
 * across the poll loop but deliberately not across reboot: the shadow
 * re-syncs on boot, which IS the persistence mechanism.
 *
 * Build-time-only knobs stay in Kconfig on purpose: buffer/stack sizes
 * (STOP_JSON_BUF_SIZE, STOP_MAX_ROUTES, ROUTE_MAX_DEPARTURES), hardware
 * shape (LIGHT_SENSOR), the watchdog window
 * (MAX_TIME_INACTIVE_BEFORE_RESET_MS -- wdt_install_timeout() happens once
 * before wdt_setup(), it cannot be re-armed at runtime), and the Swiftly
 * hostname/path/prediction-count trio (the response-buffer and parser
 * sizing above is budgeted against them at build time).
 *
 * The display-box count used to be listed here as hardware shape. It is
 * not a Kconfig option at all now: the board overlay wires a fixed set of
 * display switches and DISPLAY_BOX_CAPACITY (display/display_switches.h)
 * names how many, while how many a given sign USES follows from the
 * shadow's display mapping naming that many positions.
 */
#ifndef RUNTIME_CONFIG_H
#define RUNTIME_CONFIG_H

/** Single-word reads/writes (one writer: the pigeon client thread) -- no
 * locking needed on this core, see runtime_config.c. */
int runtime_config_http_retry_count(void);
void runtime_config_http_retry_count_set(int value);

#endif  // RUNTIME_CONFIG_H
```
